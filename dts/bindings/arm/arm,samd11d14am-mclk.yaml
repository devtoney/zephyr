## dts/bindings/arm/arm,samd11d14am-mclk.yaml
```yaml
# mclk_samd11d14am.yaml
# SPDX-License-Identifier: Apache-2.0

description: >
  Main Clock (MCLK) configuration for the SAMD11D14AM microcontroller

compatible: "atmel,samd11-mclk"

include: base.yaml

properties:
  reg:
    required: true
    type: array
    description: |
      Base address and length of the register set.
    items:
      - description: Base address of the MCLK register set
        type: int
      - description: Length of the register set
        type: int

  clocks:
    type: array
    description: |
      List of clocks this peripheral depends on.

  clock-names:
    type: array
    description: |
      List of names for the clocks in the `clocks` property.

examples:
  - |
    mclk: mclk@40000400 {
        compatible = "atmel,samd11-mclk";
        reg = <0x40000400 0x10>;
    };
```

## dts/bindings/clock/atmel,samd1x-gclk.yaml
```yaml
# Copyright (c) 2022 Kamil Serwus
# SPDX-License-Identifier: Apache-2.0

description: Atmel SAMD1x Generic Clock Controller (GCLK)

compatible: "atmel,samd1x-gclk"

include: [clock-controller.yaml, base.yaml]

properties:
  reg:
    required: true

  "#clock-cells":
    const: 1

clock-cells:
  - periph_ch
```

## samples/drivers/spi_sam0/sample.yaml
```yaml
sample:
  name: SPI FRAM Module Sample
tests:
  sample.drivers.spi.spi_sam0:
    tags:
      - drivers
      - fram
    harness: fram
    depends_on:
      - gpio
      - spi
    filter: dt_alias_exists("spi-1")
```

## soc/atmel/sam0/samd11/Kconfig.soc
```kconfig
config SOC_SERIES_SAMD11
	bool
	select SOC_FAMILY_ATMEL_SAM0
	help
	  Enable support for Atmel SAMD11 Cortex-M0+ microcontrollers.

config SOC_SERIES
	default "samd11" if SOC_SERIES_SAMD11

config SOC_SAMD11D14AM
	bool
	select SOC_SERIES_SAMD11

config SOC
	default "samd11d14am" if SOC_SAMD11D14AM
	
```
