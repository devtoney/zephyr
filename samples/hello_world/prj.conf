## prj.conf
```kconfig
# nothing here

# CONFIG_CONSOLE=n
# CONFIG_UART_CONSOLE=n
# CONFIG_PRINTK=n
# CONFIG_LOG=n
# CONFIG_HEAP_MEM_POOL_SIZE=0

# CONFIG_TEST=n
# CONFIG_SHELL=n
# CONFIG_STDOUT_CONSOLE=n
CONFIG_LOG=y
CONFIG_SERIAL=y
CONFIG_PRINTK=y
# CONFIG_GPIO=y
# CONFIG_PINCTRL=y
# CONFIG_STDOUT_CONSOLE=y
# CONFIG_UART_CONSOLE=y
```

## src/main.c
```c
/*
 * Copyright (c) 2012-2014 Wind River Systems, Inc.
 *
 * SPDX-License-Identifier: Apache-2.0
 */

 #include <stdio.h>
 #include <zephyr/kernel.h>

int main(void)
{
	while (1)
	{
		printk("Hello World! \n");
		k_msleep(100);
	}
	
	

	return 0;
}
```
